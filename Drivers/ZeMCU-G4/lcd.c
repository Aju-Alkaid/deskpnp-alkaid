#include "lcd.h"
#include <string.h>

extern SPI_HandleTypeDef hspi2;
static SPI_HandleTypeDef *hspi_lcd = NULL;
uint8_t display_buffer[LCD_BUFFER_SIZE];
/* DMA 传输完成标志 */
static volatile uint8_t dma_transfer_complete = 1;  // 1 = 空闲

/* 底层 SPI 命令/数据发送 */
static void Write_Cmd(uint8_t cmd) {
    CS_Low;
    DC_Low;
    HAL_SPI_Transmit(hspi_lcd, &cmd, 1, HAL_MAX_DELAY);
    CS_High;
}

static void Write_Data(uint8_t data) {
    CS_Low;
    DC_High;
    HAL_SPI_Transmit(hspi_lcd, &data, 1, HAL_MAX_DELAY);
    CS_High;
}

static void Write_Data_Bulk(const uint8_t *data, uint16_t len) {
    CS_Low;
    DC_High;
    HAL_SPI_Transmit(hspi_lcd, (uint8_t*)data, len, HAL_MAX_DELAY);
    CS_High;
}

/* SPI Tx 传输完成回调（DMA 模式）  */
void HAL_SPI_TxCpltCallback(SPI_HandleTypeDef *hspi)
{
    if (hspi == hspi_lcd) {
        dma_transfer_complete = 1;   // 标记传输完成
        CS_High;                     // 拉高片选
    }
}

/* 设置窗口地址（8 位参数） */
void Set_Address(uint16_t x1, uint16_t y1, uint16_t x2, uint16_t y2) {
    // 计算硬件起始和结束列地址（单位：12列）
    uint16_t hw_x1 = HARDWARE_COL_START + x1;
    uint16_t hw_x2 = HARDWARE_COL_START + x2;
    uint8_t col_start = hw_x1 / 12;
    uint8_t col_end   = hw_x2 / 12;

    // 计算硬件起始和结束行地址（单位：2行）
    uint16_t hw_y1 = HARDWARE_ROW_START + y1;
    uint16_t hw_y2 = HARDWARE_ROW_START + y2;
    uint8_t row_start = hw_y1 / 2;
    uint8_t row_end   = hw_y2 / 2;

    Write_Cmd(0x2A);   // CASET
    Write_Data(col_start);
    Write_Data(col_end);

    Write_Cmd(0x2B);   // RASET
    Write_Data(row_start);
    Write_Data(row_end);

    Write_Cmd(0x2C);   // RAMWR
}

/* 硬件复位 */
static void ST7306_HardReset(void) {
    RES_High; HAL_Delay(10);
    RES_Low;  HAL_Delay(20);
    RES_High; HAL_Delay(120);
}
/*
 * 设置电压参数，影响对比度和稳定性
 * 0xC0 的两个参数绝对值差值越大，对比度越强
 * 0xC1	源极正电压控制
 * 0xC4	源极负电压控制  二者配合可以拉大黑白电压差，从而加深黑色
*/
static void Power_Voltage_Setting(void) {
    // D1h: Booster Enable - 开启电荷泵升压电路
    // 参数: 0x01 使能
    Write_Cmd(0xD1); Write_Data(0x01);  // Booster Enable
    // C0h: Gate Voltage Control - 设置栅极驱动电压 VGH 和 VGL
    // 参数1: VGH[4:0]                0x10 = 16V     17V（最大值）
    // 参数2: VGL[4:0]  0x02 = -6.0   0x0E = -12.0 
    //注意：|VGH - VGL| 不能超过 32V
    Write_Cmd(0xC0); Write_Data(0x10); Write_Data(0x0E);
    // C1h: VSHP (Source High Positive Voltage) 正电压最大值
    // 公式: VSHPAx = 3.7 + 0.02 * N, N = 0~255
    // 0x5A = 90 -> 3.7 + 1.8 = 5.5V (适中偏强，可根据需要调整至 6.0V = 0x73)
    Write_Cmd(0xC1); Write_Data(0x5A); Write_Data(0x5A); Write_Data(0x5A); Write_Data(0x5A);
    // C2h: VSLP (Source Low Positive Voltage) 正电压最小值
    // 公式: VSLPAx = 0.02 * N, 默认 0x32 = 50 -> 1.0V
    // 默认 0x63 = 1V，若对比度不足可适当减小（如 0x23 = 35 -> 0.7V）
    Write_Cmd(0xC2); Write_Data(0x63); Write_Data(0x63); Write_Data(0x63); Write_Data(0x63);
    // C4h: VSHN (Source High Negative Voltage) 负电压绝对值
    // 公式: VSHNAx = -2.5 - 0.02 * N, 0x64 = 100 -> -4.5V
    // 可调至 -5.0V (0x7D) 以增强驱动
    Write_Cmd(0xC4); Write_Data(0x64); Write_Data(0x64); Write_Data(0x64); Write_Data(0x64);
    // C5h: VSLN (Source Low Negative Voltage) 负电压最小值
    // 公式: VSLNAx = 1 - 0.02 * N, 0x37 = 55 -> -0.1V? 实际计算为 1 - 1.1 = -0.1V
    // 默认 0x46 = 70 -> -0.4V，可根据需要调整
    Write_Cmd(0xC5); Write_Data(0x46); Write_Data(0x46); Write_Data(0x46); Write_Data(0x46);
}

/* 初始化序列 */
static void ST7306_InitSequence(void) {
    // D6h: NVM Load Control - 从非易失存储器加载配置
    // 参数1: 0x17 表示启用 VS 和 ID 加载
    // 参数2: 0x02 其他控制位
    Write_Cmd(0xD6); Write_Data(0x17); Write_Data(0x02);
    // 设置电压参数
    Power_Voltage_Setting();

    // B2h: Frame Rate Control - 帧率控制
    // 参数 0x15 -> HPM 32Hz, LPM 8Hz
    //      0x05 -> HPM 16Hz, LPM 8Hz
    // 改帧率后记得同时在cubemx中改TIM定时器配置
    Write_Cmd(0xB2); Write_Data(0x05);

    // B3h: Update Period Gate EQ Control in HPM - 高功耗模式下栅极均衡控制
    // 共10个参数，控制每一行的栅极驱动波形，一般保持默认
    Write_Cmd(0xB3); Write_Data(0xE5); Write_Data(0xF6); Write_Data(0x05);
    Write_Data(0x46); Write_Data(0x77); Write_Data(0x77);
    Write_Data(0x77); Write_Data(0x77); Write_Data(0x76); Write_Data(0x45);
    // B4h: Update Period Gate EQ Control in LPM - 低功耗模式下栅极均衡控制
    Write_Cmd(0xB4); Write_Data(0x05); Write_Data(0x46); Write_Data(0x77);
    Write_Data(0x77); Write_Data(0x77); Write_Data(0x77); Write_Data(0x76); Write_Data(0x45);
    // B7h: Source EQ Enable - 源极均衡使能
    // 0x13 表示使能（通常保持默认）
    Write_Cmd(0xB7); Write_Data(0x13);   
    //
    //注意此处
    //
    // B0h: Gate Line Setting - 设置栅极线数（关键参数！）
    // GL[6:0] 以 4 条线为单位设置行数。对于 400 行，需要 100 个单位（0~99），即 0x64。
    Write_Cmd(0xB0); Write_Data(0x64);   
    // 11h: Sleep Out - 退出睡眠模式
    Write_Cmd(0x11); HAL_Delay(120);// 重要：退出睡眠后需要足够的延时让电压稳定，至少 120ms，建议 200ms
    // D8h: OSC Setting - 内部振荡器设置
    // 参数1: 0xA6 32Hz 帧率
    // 参数2: 0xE9 其他设置
    // 内部振荡器的最大可用频率上限，决定了帧率上限，具体帧率由B2h参数决定
    Write_Cmd(0xD8); Write_Data(0xA6); Write_Data(0xE9); 
    // C9h: Source Voltage Select - 选择源极电压组 (0x00 表示使用 VSHP1/VSLP1 等)
    Write_Cmd(0xC9); Write_Data(0x00);
    // 36h: Memory Access Control - 控制数据读写方向（可配合软件旋转）
    // 0x48 = 0100 1000, 即 MX=1, MY=0, MV=0, ... 具体参考手册
    Write_Cmd(0x36); Write_Data(0x48);
    // 3Ah: Data Format - 数据格式选择（0x11 通常为 8位 8080 模式）
    Write_Cmd(0x3A); Write_Data(0x11);   // 单色模式（3 次写入 24bit）
    // B9h: Gamma Mode Setting - Gamma 模式 (0x20 表示 Mono 模式)
    Write_Cmd(0xB9); Write_Data(0x20);   // Mono
    // B8h: Panel Setting - 面板设置 (09:column  29:dot   25:dot+one line interval) (0x29 表示 Dot inversion, 逐行扫描等)
    Write_Cmd(0xB8); Write_Data(0x29);   // 点反转
    // 35h: Tearing Effect Off - 关闭撕裂效果输出（没有 TE 引脚）
    Write_Cmd(0x35); Write_Data(0x00);
    // D0h: Auto Power Down - 自动掉电控制
    // 0xFF ON - 使能，可能引起电源波动；若抖动已解决可保持，否则可改为 0x00 关闭
    Write_Cmd(0xD0); Write_Data(0x00);
    // 38h: High Power Mode - 进入高功耗模式
    Write_Cmd(0x38);
    // 39h: Low Power Mode - 进入低功耗模式
//    Write_Cmd(0x39);                     
    HAL_Delay(150);     // 重要：进入高功耗模式后需要足够的延时让电压稳定
    // 29h: Display On - 开启显示
    Write_Cmd(0x29);                     // Display ON
    // 20h: Display Inversion Off - 关闭反色显示
    // 21h: Display Inversion On
    Write_Cmd(0x21);  
    // BBh: Clear RAM - Enable Clear RAM
    Write_Cmd(0xBB); Write_Data(0x4F);   // Clear RAM
    HAL_Delay(10);
}

/* 公共 API */
void ST7306_Init(SPI_HandleTypeDef *hspi) {
    hspi_lcd = hspi;
    CS_High; DC_High; RES_High;
    ST7306_HardReset();
    ST7306_InitSequence();
    ST7306_Clear();
    ST7306_Refresh();
}

void ST7306_Clear(void) {
    memset(display_buffer, 0x00, LCD_BUFFER_SIZE);
}

void ST7306_Fill(uint8_t color) {
    memset(display_buffer, color ? 0xFF : 0x00, LCD_BUFFER_SIZE);
}

/* 像素写入（单色 1-bit，每字节 4 列 × 2 行） */
void ST7306_WritePixel(uint16_t x, uint16_t y, uint8_t color) {
    if (x >= LCD_W || y >= LCD_H) return;
    uint16_t byte_idx = (y / 2) * LCD_DATA_WIDTH + (x / 4);
    uint8_t bit = 7 - ((x % 4) * 2 + (y % 2));
    if (color == BLACK)
        display_buffer[byte_idx] |= (1 << bit);
    else
        display_buffer[byte_idx] &= ~(1 << bit);
}

void ST7306_Refresh(void) {
    // 等待上一次 DMA 传输完成（如果还在进行中）
    while (dma_transfer_complete == 0);

    // 设置显示窗口
    Set_Address(0, 0, LCD_W - 1, LCD_H - 1);

    // 启动 DMA 传输
    dma_transfer_complete = 0;       // 清除完成标志
    CS_Low;                          // 片选有效
    DC_High;                         // 数据模式

    if (HAL_SPI_Transmit_DMA(hspi_lcd, display_buffer, LCD_BUFFER_SIZE) != HAL_OK) {
        // // 如果 DMA 启动失败，回退到阻塞模式（可选）
        // dma_transfer_complete = 1;
        // CS_High;
        // Write_Data_Bulk(display_buffer, LCD_BUFFER_SIZE);
    }
}

void ST7306_FillRect(uint16_t x, uint16_t y, uint16_t w, uint16_t h, uint8_t color) {
    for (uint16_t i = 0; i < h; i++)
        for (uint16_t j = 0; j < w; j++)
            ST7306_WritePixel(x + j, y + i, color);
}

/* 8x16 ASCII 1608字符数组 */
const uint8_t asc2_1608[][16]={
{0x00,0x00,0x00,0x00,0x00,0x00,0x00,0x00,0x00,0x00,0x00,0x00,0x00,0x00,0x00,0x00},/*" ",0*/
{0x00,0x00,0x00,0x08,0x08,0x08,0x08,0x08,0x08,0x08,0x00,0x00,0x18,0x18,0x00,0x00},/*"!",1*/
{0x00,0x48,0x6C,0x24,0x12,0x00,0x00,0x00,0x00,0x00,0x00,0x00,0x00,0x00,0x00,0x00},/*""",2*/
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{0x0C,0x32,0xC2,0x00,0x00,0x00,0x00,0x00,0x00,0x00,0x00,0x00,0x00,0x00,0x00,0x00},/*"~",94*/
}; 


void LCD_ShowChar(uint16_t x, uint16_t y, char ch) {
    if (x > LCD_W - 8 || y > LCD_H - 16) return;
    uint8_t idx = ch - ' ';
    if (idx >= 95) return;
    for (uint8_t row = 0; row < 16; row++) {
        uint8_t line = asc2_1608[idx][row];
        for (uint8_t col = 0; col < 8; col++) {
            if (line & 0x01)
                ST7306_WritePixel(x + col, y + row, WHITE);
            else
                ST7306_WritePixel(x + col, y + row, BLACK);
            line >>= 1;
        }
    }
}

void LCD_ShowString(uint16_t x, uint16_t y, const char *str) {
    while (*str) {
        if (x > LCD_W - 8) { x = 0; y += 16; }
        if (y > LCD_H - 16) break;
        LCD_ShowChar(x, y, *str++);
        x += 8;
    }
}
